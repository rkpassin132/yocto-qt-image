## meta-mylayer/conf/bblayers.conf
```bitbake
BBLAYERS ?= " \
  /home/rahul/Desktop/nukepin2/poky/meta \
  /home/rahul/Desktop/nukepin2/poky/meta-poky \
  /home/rahul/Desktop/nukepin2/poky/meta-openembedded/meta-oe \
  /home/rahul/Desktop/nukepin2/poky/meta-openembedded/meta-multimedia \
  /home/rahul/Desktop/nukepin2/poky/meta-openembedded/meta-networking \
  /home/rahul/Desktop/nukepin2/poky/meta-openembedded/meta-python \
  /home/rahul/Desktop/nukepin2/poky/meta-qt5 \
  /home/rahul/Desktop/nukepin2/poky/meta-mylayer \
  "
```
